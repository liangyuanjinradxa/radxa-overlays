#include "rock-5a-radxa-hdmi-in-4k-rk628.dts"

/ {
	metadata {
		title = "Enable Radxa 4K HDMI IN to MIPI CSI-2 Adapter on CAM0";
		compatible = "radxa,rock-5-itx";
		exclusive = "csi2_dphy0", "GPIO2_B6", "GPIO1_B0", "GPIO1_A7";
		description = "Enable Radxa 4K HDMI IN to MIPI CSI-2 Adapter on CSI-0 (CAM0).";
	};
};

&rk628_csi {
	interrupt-parent = <&gpio1>;
	interrupts = <RK_PB0 IRQ_TYPE_LEVEL_HIGH>;
	reset-gpios = <&gpio2 RK_PB6 GPIO_ACTIVE_LOW>;
	plugin-det-gpios = <&gpio1 RK_PA7 GPIO_ACTIVE_LOW>;
};

&rk628_pin {
	rockchip,pins =
		<1 RK_PB0 RK_FUNC_GPIO &pcfg_pull_none>,
		<2 RK_PB6 RK_FUNC_GPIO &pcfg_pull_none>,
		<1 RK_PA7 RK_FUNC_GPIO &pcfg_pull_none>;
};
